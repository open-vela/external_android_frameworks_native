## libs/Kconfig
```kconfig
#
# Copyright (C) 2023 Xiaomi Corporation
#
# Licensed under the Apache License, Version 2.0 (the "License");
# you may not use this file except in compliance with the License.
# You may obtain a copy of the License at
#
#      http://www.apache.org/licenses/LICENSE-2.0
#
# Unless required by applicable law or agreed to in writing, software
# distributed under the License is distributed on an "AS IS" BASIS,
# WITHOUT WARRANTIES OR CONDITIONS OF ANY KIND, either express or implied.
# See the License for the specific language governing permissions and
# limitations under the License.
#

config ANDROID_BINDER
	bool "Android Binder"
	depends on TLS_TASK_NELEM > 0
	depends on TLS_NELEM > 0
	select ANDROID_LIBUTILS
	default n
	---help---
		Android binder, the codebase come from AOSP

config ANDROID_BINDER_THREADPOOL_STACKSIZE
	int "Android Binder Thread pool stacksize"
	depends on ANDROID_BINDER
	default 8192

config ANDROID_BINDER_TEST
	tristate "Android Binder Test Case"
	depends on LIB_GOOGLETEST
	depends on ANDROID_SERVICEMANAGER
	default n

config ANDROID_BINDER_TEST_STACKSIZE
	int "Android Binder Test stack size"
	depends on ANDROID_BINDER_TEST
	default DEFAULT_TASK_STACKSIZE

config ANDROID_BINDER_LIB_TEST
	bool "Android Binder Lib Test Case"
	depends on ANDROID_BINDER_TEST
	depends on LIBC_EXECFUNCS
	default n

config ANDROID_BINDER_DRIVER_TEST
	bool "Android Binder Driver Test Case"
	depends on ANDROID_BINDER_TEST
	default n

config ANDROID_BINDER_PERFORMANCE_TEST
	bool "Android Binder Performance Test"
	depends on ANDROID_BINDER_TEST
	default n

config ANDROID_BINDER_XPC_PERFORMANCE_TEST
	bool "Android Binder RPC and CPC Performance Test"
	depends on ANDROID_BINDER && LIB_GOOGLEBENCHMARK
	default n

config ANDROID_BINDER_RPC_PERFORMANCE_TEST
	bool "Android Binder RPC Binder Performance Test"
	depends on ANDROID_BINDER_XPC_PERFORMANCE_TEST
	default n

config ANDROID_BINDER_CPC_PERFORMANCE_TEST
	bool "Android Binder CPC Binder Performance Test"
	depends on ANDROID_BINDER_XPC_PERFORMANCE_TEST
	default n

config RPMSGSOCK_PERFORMANCE_TEST
	bool "rpmsg socket Performance Test"
	depends on ANDROID_BINDER_XPC_PERFORMANCE_TEST
	default n
```
